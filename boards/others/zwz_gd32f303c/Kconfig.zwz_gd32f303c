## boards/others/zwz_gd32f303c/Kconfig.zwz_gd32f303c
```kconfig
# Copyright (c) 2026 Zewen Zhu
# SPDX-License-Identifier: Apache-2.0

config BOARD_ZWZ_GD32F303C
	select SOC_GD32F303
```

## boards/others/zwz_gd32f303c/board.yml
```yaml
board:
  name: zwz_gd32f303c
  full_name: ZWZ GD32F303CBT6
  vendor: others
  socs:
    - name: gd32f303
```

## soc/gd/gd32/gd32f30x/Kconfig.defconfig.series
```kconfig
# Copyright (c) 2021, ATL Electronics
# Copyright (c) 2026 Zewen Zhu
# SPDX-License-Identifier: Apache-2.0

if SOC_SERIES_GD32F30X

rsource "Kconfig.defconfig.gd32*"

endif # SOC_SERIES_GD32F30X
```

## soc/gd/gd32/gd32f30x/Kconfig.soc
```kconfig
# Copyright (c) 2021, ATL Electronics
# Copyright (c) 2026 Zewen Zhu
# SPDX-License-Identifier: Apache-2.0

config SOC_SERIES_GD32F30X
	bool
	select SOC_FAMILY_GD_GD32
	help
	  Enable support for GigaDevice GD32F30x MCU series (F301/F302/F303/
	  F305/F307, Cortex-M4, high-density)

config SOC_SERIES
	default "gd32f30x" if SOC_SERIES_GD32F30X

config SOC_GD32F303
	bool
	select SOC_SERIES_GD32F30X

config SOC
	default "gd32f303" if SOC_GD32F303
```
