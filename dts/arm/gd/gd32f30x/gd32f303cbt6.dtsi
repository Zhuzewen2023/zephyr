/*
 * Copyright (c) 2026 Zewen Zhu
 *
 * SPDX-License-Identifier: Apache-2.0
 */

#include <mem.h>
#include <gd/gd32f30x/gd32f30x.dtsi>

&flash0 {
	reg = <0x08000000 DT_SIZE_K(128)>;
	ranges = <0x0 0x08000000 DT_SIZE_K(128)>;
};

&sram0 {
	reg = <0x20000000 DT_SIZE_K(32)>;
};
